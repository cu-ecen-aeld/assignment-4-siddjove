## base_external/Config.in
```kconfig
menu "Project Base external options"

# Your external packages will be sourced here
source "$BR2_EXTERNAL_PROJECT_BASE_PATH/package/Config.in"

endmenu
```

## base_external/package/Config.in
```kconfig
menu "AESD custom packages"
    source "aesd-assignments/Config.in"
endmenu
source "$BR2_EXTERNAL_PROJECT_BASE_PATH/package/aesd-assignments/Config.in"
```

## base_external/package/aesd-assignments/Config.in
```kconfig
config BR2_PACKAGE_AESD_ASSIGNMENTS
	bool "aesd-assignments"
	help
	  Build and install the AESD assignment tools (writer, finder, scripts).
	  Pulls your assignment-3 repository via SSH.
```
